/dts-v1/;
/plugin/;

/ {
    compatible = "allwinner,sun50i-h616", "allwinner,sun50i-h618";

    fragment@0 {
        target-path = "/";
        __overlay__ {
            ir_receiver {
                compatible = "gpio-ir-receiver";
                gpios = <&pio 7 10 1>; /* Port H, Pin 10 (Physical Pin 33) */
            };
            ir_transmitter {
                compatible = "gpio-ir-tx";
                gpios = <&pio 8 1 0>;  /* Port I, Pin 1 (Physical Pin 12) */
            };
        };
    };
};
