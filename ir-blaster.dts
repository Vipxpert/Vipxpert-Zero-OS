/dts-v1/;
/plugin/;

/ {
    compatible = "allwinner,sun50i-h618", "allwinner,sun50i-h616";

    fragment@0 {
        target-path = "/";
        __overlay__ {
            ir_tx {
                compatible = "gpio-ir-tx";
                gpios = <&pio 8 9 0>; /* Bank I, Pin 9 = Physical Pin 12 */
            };
        };
    };
};
